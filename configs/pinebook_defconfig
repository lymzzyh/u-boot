## configs/pinebook_defconfig
```kconfig
CONFIG_ARM=y
CONFIG_ARCH_SUNXI=y
CONFIG_MACH_SUN50I=y
CONFIG_RESERVE_ALLWINNER_BOOT0_HEADER=y
CONFIG_DRAM_CLK=552
CONFIG_DRAM_ODT_EN=y
CONFIG_VIDEO_LCD_MODE="x:1366,y:768,depth:18,pclk_khz:72000,hs:54,vs:5,le:10,ri:70,up:15,lo:12,sync:3,mode:0"
CONFIG_VIDEO_LCD_RESET="PD24"
CONFIG_VIDEO_LCD_BL_EN="PD23"
CONFIG_VIDEO_LCD_BL_PWM="PD22"
# CONFIG_VIDEO_LCD_BL_PWM_ACTIVE_LOW is not set
CONFIG_VIDEO_LCD_POWER="PH6"
CONFIG_VIDEO_LCD_PANEL_I2C_SDA="PL9"
CONFIG_VIDEO_LCD_PANEL_I2C_SCL="PL8"
CONFIG_VIDEO_LCD_PANEL_EDP_1620M_VIA_ANX=y
CONFIG_ANX_LANE_NUM=1
CONFIG_DEFAULT_DEVICE_TREE="sun50i-a64-pinebook"
# CONFIG_SYS_MALLOC_CLEAR_ON_INIT is not set
CONFIG_FIT=y
CONFIG_SPL_FIT=y
CONFIG_SPL_LOAD_FIT=y
CONFIG_SPL_FIT_GENERATOR="board/sunxi/mksunxi_fit_atf.sh"
CONFIG_SPL=y
# CONFIG_CMD_IMLS is not set
# CONFIG_CMD_FLASH is not set
# CONFIG_CMD_FPGA is not set
# CONFIG_SPL_DOS_PARTITION is not set
# CONFIG_SPL_ISO_PARTITION is not set
# CONFIG_SPL_EFI_PARTITION is not set
CONFIG_PHYLIB=y
# CONFIG_NETDEVICES is not set
CONFIG_USB_EHCI_HCD=y
CONFIG_SPL_OF_LIBFDT=y
```
